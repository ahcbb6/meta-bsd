## conf/distro/freebsd.conf
```bitbake
DISTRO = "freebsd"
DISTRO_NAME = "FreeBSD bootstrap"
DISTRO_VERSION = "${FREEBSD_VERSION}"
BSD_OS_VARIANT ?= "FreeBSD@OpenEmbedded - meta-bsd"
BSD_OS_VARIANT_ID ?= "meta-bsd"
BSD_MOTD_MESSAGE ?= "FreeBSD@OpenEmbedded - meta-bsd"
TCLIBC = "freebsd"
INIT_MANAGER = "bsd"
PREFERRED_PROVIDER_virtual/kernel = "freebsd-base"
FILESYSTEM_PERMS_TABLES:class-target = "files/fs-perms-freebsd.txt"
TOOLCHAIN:class-target = "clang"
DISTRO_FEATURES = "ld-is-lld"
DISTRO_FEATURES_DEFAULTS = ""
DISTRO_FEATURES_NATIVE = ""
DISTRO_FEATURES_NATIVESDK = ""
INHERIT_DISTRO = "devshell sstate license buildstats bsd-siteinfo bsd-elf"
LLVM_TARGETS_TO_BUILD:pn-llvm-native = "X86"
# Upstream bootstrap code directly executes the external kill command.
HOSTTOOLS += "kill"
require conf/distro/include/freebsd-source.inc
require conf/distro/include/freebsd-qemu.inc
```

## conf/distro/include/freebsd-15.1.inc
```bitbake
FREEBSD_BRANCH = "releng/15.1"
FREEBSD_SRCREV = "95719d8a895bf8170851e9844d9b4092b1d2b6fe"
```

## conf/distro/include/freebsd-source.inc
```bitbake
FREEBSD_VERSION ?= "15.1"
FREEBSD_TARGET_OS = "freebsd${FREEBSD_VERSION}"
require conf/distro/include/freebsd-${FREEBSD_VERSION}.inc

REQUIRED_VERSION_freebsd-base = "${FREEBSD_VERSION}"
REQUIRED_VERSION_freebsd-tools-native = "${FREEBSD_VERSION}"
```

## conf/distro/include/tclibc-freebsd.inc
```bitbake
LIBCOVERRIDE = ":libc-freebsd"
TARGET_OS = "${FREEBSD_TARGET_OS}"
MODIFYTOS = "0"
BASECANADIANEXTRAOS = ""
BASE_LIB = "lib"
BASE_LIB:tune-x86-64 = "lib"
BASE_LIB:tune-x86-64-v3 = "lib"
BASE_LIB:tune-cortexa57 = "lib"
PREFERRED_PROVIDER_virtual/libc = "freebsd-base"
PREFERRED_PROVIDER_virtual/libiconv = "freebsd-base"
PREFERRED_PROVIDER_virtual/crypt = "freebsd-base"
# FreeBSD world supplies compiler-rt, libc++ and its libgcc compatibility ABI.
PREFERRED_PROVIDER_virtual/${MLPREFIX}compilerlibs:libc-freebsd = "freebsd-base"
PREFERRED_PROVIDER_compiler-rt = "freebsd-base"
PREFERRED_PROVIDER_libcxx = "freebsd-base"
PREFERRED_PROVIDER_openssl = "freebsd-base"
PREFERRED_PROVIDER_zlib = "freebsd-base"
PREFERRED_PROVIDER_ncurses = "freebsd-base"
PREFERRED_PROVIDER_bzip2 = "freebsd-base"
PREFERRED_PROVIDER_xz = "freebsd-base"
PREFERRED_RPROVIDER_base-files = "freebsd-base-files"
PKG_CONFIG_PATH:append:class-target = ":${STAGING_DIR_HOST}${prefix}/libdata/pkgconfig"
SYSROOT_DIRS:append:class-target = " ${prefix}/libdata"
FILES:${PN}-dev:append:class-target = " ${prefix}/libdata/pkgconfig"
# llvm-ar dispatches by argv[0]; a dotted target version is mistaken for a suffix.
AR:class-target = "llvm-ar"
RANLIB:class-target = "llvm-ranlib"
READELF:class-target = "llvm-readelf"
LIBC_DEPENDENCIES = "freebsd-base"
IMAGE_LINGUAS = ""
```
